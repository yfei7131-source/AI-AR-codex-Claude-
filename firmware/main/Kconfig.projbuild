## firmware/main/Kconfig.projbuild
```kconfig
menu "AI/AR Glasses device"
choice GL_BOARD
    prompt "Board profile (does not certify privacy interlock)"
    default GL_BOARD_UNCONFIGURED
config GL_BOARD_UNCONFIGURED
    bool "Unconfigured: never access camera/audio/button GPIO"
config GL_BOARD_EYE_V22
    bool "Espressif ESP32-S3-EYE MB v2.2 (camera locked: privacy interlock not verified)"
config GL_BOARD_S3_CARRIER_A
    bool "S3-CARRIER-A / DevKitC-1 v1.1 N16R8 (bench, camera locked)"
config GL_BOARD_AIAR_EVT0_R3
    bool "AI/AR EVT-0 R3 N16R8 (unpopulated camera, privacy unverified)"
endchoice
config GL_MEDIA_DEV_AP
    bool "Enable local development AP/media server after physical pairing window"
    default n
    help
        Disabled by default. Does not unlock camera privacy interlocks.
        Requires >=3s physical button pairing window and explicit encrypted BLE session open.
        Development-only WPA2 + short-lived bearer HTTP, not production ownership/TLS certification.
config GL_MEDIA_TX_POWER_QDBM
    int "Development AP TX power ceiling (quarter dBm, driver quantizes)"
    range 8 80
    default 44
    help
        44 requests the 11 dBm driver step. Readback is logged after AP start.
        This ceiling does not establish board peak current or regulatory compliance.
endmenu
```

## firmware/sdkconfig.defaults
```kconfig
CONFIG_IDF_TARGET="esp32s3"
CONFIG_BT_ENABLED=y
CONFIG_BT_NIMBLE_ENABLED=y
CONFIG_BT_NIMBLE_ROLE_CENTRAL=n
CONFIG_BT_NIMBLE_ROLE_PERIPHERAL=y
CONFIG_BT_NIMBLE_MAX_CONNECTIONS=1
CONFIG_BT_NIMBLE_SM_SC=y
CONFIG_BT_NIMBLE_NVS_PERSIST=y
CONFIG_ESP_CONSOLE_USB_SERIAL_JTAG=y
CONFIG_ESP_MAIN_TASK_STACK_SIZE=8192
CONFIG_GL_BOARD_UNCONFIGURED=y
```

## hardware-h01/firmware(ESP-IDF 固件工程)/main/Kconfig.projbuild
```kconfig
menu "AI/AR Glasses device"
choice GL_BOARD
    prompt "Board profile (does not certify privacy interlock)"
    default GL_BOARD_UNCONFIGURED
config GL_BOARD_UNCONFIGURED
    bool "Unconfigured: never access camera/audio/button GPIO"
config GL_BOARD_EYE_V22
    bool "Espressif ESP32-S3-EYE MB v2.2 (camera locked: privacy interlock not verified)"
endchoice
config GL_MEDIA_DEV_AP
    bool "Enable local development AP/media server after physical pairing window"
    default n
    help
        Disabled by default. Does not unlock camera privacy interlocks.
        Requires >=3s physical button pairing window and explicit encrypted BLE session open.
        Development-only WPA2 + short-lived bearer HTTP, not production ownership/TLS certification.
endmenu
```
